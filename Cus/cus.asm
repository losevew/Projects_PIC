
;--------------------------------- "ШАПКА"  ПРОГРАММЫ ----------------------------------------
;*********************************************************************************************
; Файл текста программы: cus_2.asm          ВАРИАНТ КОММЕНТАРИЯ № 2
; Программа разработана для устройства тонального вызова с частотой 1450 Гц.
;********************************************************************************************* 
; Автор: Корабельников Евгений Александрович  г.Липецк,  январь 2005г.
; E-mail: karabea@lipetsk.ru                   URL: http://ikarab.narod.ru
;*********************************************************************************************
; Используется микроконтроллер PIC16F84A. Частота кварца 4000кГц.
;*********************************************************************************************
; Объем программы: 46 слов в памяти программ.
;*********************************************************************************************

;=============================================================================================
; В "шапке" программы используются директивы: LIST, __CONFIG, equ, org.
;============================================================================================= 
            LIST       p=16F84A    ; Назначение типа ПИКа: PIC16F84A.
            __CONFIG   03FF5H      ; Установка битов  конфигурации: стандартный XT-генератор,
                                   ; WDT включен, бит защиты не установлен, PWRT
                                   ; включен (1111 0101).
;=============================================================================================
; Определение адресов регистров специального назначения.
;=============================================================================================
OptionR     equ        01h         ; Регистр Option - банк1
Status      equ        03h         ; Регистр Status
PortB       equ        06h         ; Порт B
TrisB       equ        06h         ; Регистр Tris B - Банк1
IntCon      equ        0Bh         ; Регистр IntCon
;=============================================================================================
; Определение названия и адресов регистров общего назначения.
;=============================================================================================
Sec         equ        0Ch         ; Счетчик времени полупериода.

SecH        equ        0Dh         ; Старший байт таймера.
SecL        equ        0Eh         ; Младший байт таймера.
;=============================================================================================
; Присвоение буквенного обозначения операции направления результата выполнения команды в
; регистр, с содержимым которого производится действие (для удобства восприятия текста
; программы).
;=============================================================================================
F           equ        1           ; Результат направить в регистр, с содержимым которого
                                   ; производится действие.
;=============================================================================================
; Присвоение биту выбора банка регистра STATUS (пятому) его стандартного названия 
; для удобства восприятия текста программы).
;=============================================================================================
RP0         equ        5           ; Присвоение 5-му биту регистра STATUS названия RP0.
;=============================================================================================
; Определение точки входа в программу.
;=============================================================================================
            org        0           ; Установка нулевого адреса в счетчике команд PC.
            goto       START       ; Безусловный переход на подпрограмму START.
;*********************************************************************************************

;------------------------------- РАБОЧАЯ  ЧАСТЬ  ПРОГРАММЫ -----------------------------------
;*********************************************************************************************
; Подготовительные операции.
;---------------------------------------------------------------------------------------------
START       clrf       IntCon      ; Сброс в ноль всех битов регистра IntCon.

            clrwdt                 ; Установка начала отсчета сторожевого таймера WDT.

            bsf        Status,RP0  ; Установка 5-го бита регистра Status в единицу.

            movlw      .65         ; Запись в регистр W константы .65        (.65 = 0100 0001)
            movwf      TrisB       ; Установка нулевого и 6-го бита регистра TrisB
                                   ; в единицу, а остальных - в ноль.

            movlw      .143        ; Запись в регистр W константы .143      (.143 = 1000 1111)
            movwf      OptionR     ; Установка 4,5,6-го битов регистра OptionR  
                                   ; в ноль, а остальных - в единицу.

            bcf        Status,RP0  ; Установка 5-го бита регистра Status в ноль.                        
;--------------------------------------------------------------------------------------------
; Запись констант времени работы таймера.
;--------------------------------------------------------------------------------------------
            movlw      .15         ; Запись в регистр W константы .15
            movwf      SecH        ; Копирование константы .15 из регистра W в регистр SecH.

            movlw      .255        ; Запись в регистр W константы .255
            movwf      SecL        ; Копирование константы .255 из регистра W в регистр SecL.
;--------------------------------------------------------------------------------------------
; Проверка наличия включения на передачу (опрос клавиатуры).
;--------------------------------------------------------------------------------------------
CYCLE       btfsc      PortB,0     ; Если нулевой бит регистра PortB равен 1, то выполняется
                                   ; следующая команда (goto START), а если равен 0, то сле-
                                   ; дующая команда не выполняется (вместо нее - nop) и
                                   ; следующей активной командой будет btfss PortB,6

            goto       START       ; Безусловный переход на подпрограмму START.
;--------------------------------------------------------------------------------------------
; Проверка: режим тонального вызова включен или выключен ?
;--------------------------------------------------------------------------------------------
            btfss      PortB,6     ; Если 6-й бит регистра PortB равен 0, то выполняется сле-
                                   ; дующая команда (goto PRD), а если равен 1, то следующая
                                   ; команда не выполняется (вместо нее - nop) и следующей
                                   ; активной командой будет bcf PortB,2

            goto       PRD         ; Безусловный переход на подпрограмму PRD. 
;--------------------------------------------------------------------------------------------
; Формирование времени отрицательного полупериода сигнала тонального вызова.
;--------------------------------------------------------------------------------------------
            bcf        PortB,2     ; Установить 2-й бит регистра PortB в 0.
            nop                    ; Пустые машинные циклы.
            nop                    ; ----------"-----------
            nop                    ; ----------"-----------
      
            movlw      .85         ; Запись в регистр W константы .85 
            movwf      Sec         ; Копирование константы .85 из регистра W в регистр Sec.

PAUSE_1     clrwdt                 ; Установка начала отсчета сторожевого таймера WDT.
          
            decfsz     Sec,F       ; Декремент (-1) содержимого регистра Sec с сохранением
                                   ; результата декремента в нем же.
                                   ; Если этот результат не=0, то выполняется следующая коман-
                                   ; да (goto PAUSE_1), а если =0, то следующая команда не
                                   ; выполняется (вместо нее - nop) и следующей активной
                                   ; командой будет bsf PortB,2

            goto       PAUSE_1     ; Безусловный переход на подпрограмму PAUSE_1.
;--------------------------------------------------------------------------------------------
; Формирование времени положительного полупериода сигнала тонального вызова.
;--------------------------------------------------------------------------------------------                      
            bsf        PortB,2     ; То же самое, что и при формировании
            nop                    ; отрицательного полупериода, только
            nop                    ; 2-й бит регистра PortB
            nop                    ; устанавливается в 1.

            movlw      .83         ; То же самое, что и при формировании отрицательного полу- 
            movwf      Sec         ; периода, только в регистр Sec записывается константа .83

PAUSE_2     clrwdt                 ; Установка начала отсчета сторожевого таймера WDT.
          
            decfsz     Sec,F       ; То же самое, что и при формировании отрицательного полу-
            goto       PAUSE_2     ; периода, только безусловный переход осуществляется
                                   ; на подпрограмму PAUSE_2.
;--------------------------------------------------------------------------------------------
; "Очистка" (декремент) таймера.
;--------------------------------------------------------------------------------------------          
            decfsz     SecL,F      ; Декремент (-1) содержимого регистра SecL с сохранением
            goto       CYCLE       ; результата в нем же.                    
                                   ; Если этот результат не=0, то выполняется следующая коман-
                                   ; да (goto CYCLE), а если =0, то следующая команда не
                                   ; выполняется (вместо нее - nop) и следующей активной
                                   ; командой будет decfsz SecH,F

            decfsz     SecH,F      ; То же самое, что и при декременте содержимого регистра
            goto       CYCLE       ; SecL, только применительно к регистру SecH.

            bcf        PortB,2     ; Установить 2-й бит регистра PortB в 0.
;--------------------------------------------------------------------------------------------
; Уход рабочей точки программы в "вечное" кольцо и выход из него после
; переключения р/станции с передачи на прием.
;--------------------------------------------------------------------------------------------
PRD         clrwdt                 ; Установка начала отсчета сторожевого таймера WDT.


            btfss      PortB,0     ; Если нулевой бит регистра PortB равен 0, то выполняется
                                   ; следующая команда (goto PRD), а если равен 1, то сле-
                                   ; дующая команда не выполняется (вместо нее - nop) и
                                   ; следующей активной командой будет btfss PortB,0
 
            goto       PRD         ; Безусловный переход на подпрограмму PRD.
                                    
;           Еще одна проверка.

            btfss      PortB,0     ; То же самое, что и при первой проверке, только, при
                                   ; равенстве нулевого бита регистра PortB единице, 
                                   ; следующей активной командой будет goto START.
 
            goto       PRD         ; Безусловный переход на подпрограмму PRD.

            goto       START       ; Безусловный переход на подпрограмму START. 
       
;============================================================================================
            end                    ; Директива конца текста программы.