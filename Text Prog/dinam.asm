;***********************************************************************************************
;          ГРУППА ПОДПРОГРАММ 8-РАЗРЯДНОЙ ДИНАМИЧЕСКОЙ ИНДИКАЦИИ С ИСПОЛЬЗОВАНИЕМ
;                                ВНЕШНЕГО ДЕШИФРАТОРА.                  
;***********************************************************************************************
    

;***********************************************************************************************
;                                 "ШАПКА ПРОГРАММЫ"
;***********************************************************************************************
; Dinam.asm   Универсальная группа подпрограмм 8-разрядной динамической индикации.
;.............................................................
;===============================================================================================
; Определение положения регистров специального назначения. 
;===============================================================================================
Indf        equ        00h         ; Регистр INDF.
PC          equ        02h         ; Регистр счетчика команд.
Status      equ        03h         ; Регистр Status.
FSR         equ        04h         ; Регистр FSR.
PortA       equ        05h         ; Регистр PortA.
PortB       equ        06h         ; Регистр PortB.
;.............................................................
;.............................................................
;===============================================================================================
; Определение названия и положения регистров общего назачения.
;===============================================================================================
LED0        equ        10h         ; Регистр 1-го 7-сегментного индикатора.
LED1        equ        11h         ; ------- 2-го -------------------------
LED2        equ        12h         ; ------- 3-го -------------------------
LED3        equ        13h         ; ------- 4-го -------------------------
LED4        equ        14h         ; ------- 5-го -------------------------
LED5        equ        15h         ; ------- 6-го -------------------------
LED6        equ        16h         ; ------- 7-го -------------------------
LED7        equ        17h         ; ------- 8-го -------------------------
Index       equ        0Ch         ; Регистр счетчика количества малых колец индикации.
Count       equ        0Dh         ; Регистр счетчика количества больших колец индикации.
Temp        equ        0Fh         ; Регистр временного хранения данных.
;.............................................................
;.............................................................
;===============================================================================================
; Определение места размещения результатов операций.
;===============================================================================================
W           equ        0           ; Результат направить в аккумулятор.
F           equ        1           ; Результат направить в регистр.
;===============================================================================================
; Присваивание битам названий.
;===============================================================================================
Z           equ        2           ; Флаг нулевого результата.
;.............................................................
;.............................................................
;===============================================================================================
; Присваивание константам названий.
;===============================================================================================
Const1      equ        Y1          ; Y1 - значение времязадающей константы "грубо" (до .255).
                                   ; Задается программистом.
Const2      equ        Y2          ; Y2 - значение времязадающей константы "точно" (до .255).
                                   ; Задается программистом.       
;===============================================================================================
            org        0           ; Начать выполнение программы 
            goto       START       ; с подпрограммы START.
;***********************************************************************************************

 

;***********************************************************************************************
;                               РАБОЧАЯ ЧАСТЬ ПРОГРАММЫ
;***********************************************************************************************
; Подготовительные операции.
;-----------------------------------------------------------------------------------------------
;START       ......................................
;            ......................................
;-----------------------------------------------------------------------------------------------
; Группа подпрограмм преобразования двоичных чисел в двоично-десятичные.
;-----------------------------------------------------------------------------------------------
;Bin2_10     ......................................
;            ......................................
;.......     ......................................
;            ......................................
;.......     ......................................
;            ......................................
;   На данный момент, регистры LED0 ... LED7 заполнены двоично-десятичными числами, которые
;   необходимо вывести на индикацию (отобразить) в линейку из 8-ми 7-сегментных индикаторов.

;   На момент начала группы подпрограмм динамической индикации, все прерывания должны быть
;   запрещены, все выводы порта В и первые 3 вывода порта А должны быть настроены на работу
;   "на выход", работа должна происходить в нулевом банке.
;***********************************************************************************************
; Подготовка счетчика количества малых колец индикации Index к началу полного цикла 
; динамической индикации.
;-----------------------------------------------------------------------------------------------
            clrf        Index       ; Сброс в 0 содержимого счетчика малых колец индикации Index.
;-----------------------------------------------------------------------------------------------
; Предварительная закладка количества больших колец индикации, которое нужно "пройти" за один
; полный цикл динамической индикации в регистр Count.
;-----------------------------------------------------------------------------------------------
            movlw       X           ; Запись константы X (количество больших колец индикации,
                                    ; задается программистом) в регистр W.
            movwf       Count       ; Копирование содержимого регистра W в регистр счетчика
                                    ; количества больших колец индикации Count.
;+++++++++++++++++++++++++++++++++++++++++++++++++++++++++++++++++++++++++++++++++++++++++++++++
; Использование косвенной адресации при работе с таблицей данных.
;===============================================================================================
; Подготовка к косвенной адресации: запись в регистр W адреса регистра младшего разряда
; линейки 7-сегментных индикаторов ("привязка" к 7-сегментному индикатору, с активации которого 
; начинается полный цикл первого большого кольца индикации).
;-----------------------------------------------------------------------------------------------
CYCLE       movlw       LED0        ; Запись в регистр W адреса регистра LED0.
            addwf       Index,W     ; Увеличение адреса регистра LED0 на величину числа,
                                    ; записанного в регистре счетчика количества малых колец
                                    ; индикации Index, c сохранением результата в регистре W.                                   
;-----------------------------------------------------------------------------------------------
; Косвенная адресация.
;-----------------------------------------------------------------------------------------------
            movwf       FSR         ; Копирование содержимого регистра W в регистр FSR.
            movf        Indf,W      ; Копирование содержимого регистра с адресом, записанным
                                    ; в регистре FSR, в регистр W.
            call        TABLE       ; Условный переход (адрес следующей команды закладывается
                                    ; в стек) в ПП TABLE.
;+++++++++++++++++++++++++++++++++++++++++++++++++++++++++++++++++++++++++++++++++++++++++++++++
; Группа команд установки запятой.
;-----------------------------------------------------------------------------------------------
;---> Возврат по стеку из ПП TABLE
            movwf       Temp        ; Копирование содержимого регистра W (7-сегментные коды 
                                    ; индицируемых двоично-десятичных чисел) в регистр Temp.
            movlw       5           ; Запись в регистр W константы .05.
            bsf         Status,Z    ; Поднятие флага нулевого результата Z.
            subwf       Index,W     ; Вычесть содержимое регистра W (число .05) из содержимого
                                    ; регистра Index (числа от .00 до .07).
            btfss       Status,Z    ; Проверка состояния флага Z.
            goto        No_Dot      ; Если флаг Z опущен (результат операции не=0), то переход
                                    ; в ПП No_Dot (запятая не выставляется). 
            bsf         Temp,7      ; Если флаг Z поднят (результат операции=0), то установка
                                    ; в единицу 7-го бита (установка запятой) регистра Temp.
;-----------------------------------------------------------------------------------------------
; Группа команд вывода десятичной цифры на индикацию.
;-----------------------------------------------------------------------------------------------
No_Dot      movf        Temp,W      ; Копирование содержимого регистра Temp (7-сегментные коды
                                    ; индицируемых двоично-десятичных чисел) в регистр W.
            movwf       PortB       ; Копирование содержимого регистра W в 8 защелок порта В.
;-----------------------------------------------------------------------------------------------
; Группа команд формирования адресного кода управления дешифратором.
;-----------------------------------------------------------------------------------------------
            movf        Index,W     ; Копирование содержимого регистра Index в регистр W.
            movwf       PortA       ; Копирование содержимого регистра W в первые 3 защелки
                                    ; порта А (работа "на выход"), управляющие адресными входами
                                    ; внешнего дешифратора.
;-----------------------------------------------------------------------------------------------
; Группа команд задержки, определяющей время нахождения одного 7-сегментного индикатора
; в активном состоянии (определяющей время прохождения малого кольца индикации).
; "Грубое" формирование времени полного цикла динамической индикации.
;-----------------------------------------------------------------------------------------------
            movlw       Const1      ; Запись в регистр W константы Y1 (см. "шапку").
            movwf       Temp        ; Копирование содержимого регистра W в регистр Temp.

PAUSE       decfsz      Temp,F      ; Декремент содержимого регистра Temp c сохранением 
                                    ; результата в нем же.
            goto        PAUSE       ; Если результат декремента не=0, то переход в ПП PAUSE.
                                    ; Если результат декремента =0, то программа исполняется далее.
;-----------------------------------------------------------------------------------------------
; Увеличение на 1 содержимого счетчика количества малых колец индикации Index с последующей
; проверкой результата инкремента на равенство (или нет) числу .08.
;-----------------------------------------------------------------------------------------------
            incf        Index,F     ; Увеличение на 1 содержимого регистра Index с сохранением
                                    ; результата в нем же.
            movlw       .08         ; Запись в регистр W константы .08.
            bcf         Status,Z    ; Сброс флага нулевого результата Z.
            subwf       Index,W     ; Вычесть из содержимого регистра Index содержимое регистра
                                    ; W с сохранением результата в регистре W.
            btfss       Status,Z    ; Результат операции вычитания равен или нет нулю? 
            goto        CYCLE       ; Если не =0 (в регистре Index - число не равное 8), то
                                    ; переход к циклу активизации следующего по старшинству
                                    ; 7-сегментного индикатора (переход на новое малое
                                    ; кольцо индикации, то есть, в ПП CYCLE).
                                    ; Если =0 (в регистре Index - число равное 8), то программа
                                    ; исполняется далее.
;-----------------------------------------------------------------------------------------------
; Начало перехода на новое большое кольцо индикации после того, как последовательно активизиру- 
; ются все 8 7-сегментных индикатора линейки (после прохождения 8-ми малых колец индикации).
;-----------------------------------------------------------------------------------------------
            nop                     ; Выравнивающий NOP. 
            clrf        Index       ; Сброс в 0 содержимого регистра Index.
;-----------------------------------------------------------------------------------------------
; Уменьшение на 1 содержимого счетчика количества больших колец индикации Count.
;-----------------------------------------------------------------------------------------------
            decfsz      Count,F     ; Декремент содержимого счетчика количества больших колец
                                    ; индикации Count с сохранением результата в нем же.
            goto        CYCLE       ; Если результат декремента не=0, то переход в ПП CYCLE 
                                    ; (переход на новое большое кольцо индикации).
                                    ; Если результат декремента =0, то программа исполняется далее
                                    ; (переход на новый полный цикл динамической индикации).
            nop                     ; Выравнивающий NOP.
;===============================================================================================
; Группы подпрограмм и команд, осуществляющие различные операции.
;===============================================================================================
; "Точное" формирование времени полного цикла динамической индикации (если тебуется
; точно калиброванное время полного цикла динамической индикации для использования его
; в качестве измерительного интервала).
;-----------------------------------------------------------------------------------------------
            movlw       Const2      ; Запись в регистр W константы Y2 (см. "шапку").
            movwf       Temp        ; Копирование содержимого регистра W в регистр Temp.

PAUSE_1     decfsz      Temp,F      ; Декремент содержимого регистра Temp с сохранением
                                    ; результата в нем же.
            goto        PAUSE_1     ; Если результат декремента не=0, то переход в ПП PAUSE_1.
                                    ; Если результат декремента =0, то программа исполняется далее.
;-----------------------------------------------------------------------------------------------
; Гашение активного разряда линейки.
;-----------------------------------------------------------------------------------------------
            movlw       0           ; Запись в регистр W константы .00.
            movwf       PortB       ; Сброс в 0 всех защелок порта В.
;-----------------------------------------------------------------------------------------------
;           ........................................
;           ........................................
;           ........................................
;           ........................................
;           ........................................
;           ........................................
;  На данный момент, регистры LED0 ... LED7 заполнены двоичными числами, которые, в дальнейшем,
;  нужно преобразовать в двоично-десятичные и сохранить их все в тех же регистрах LED0 ... LED7.

            goto        Bin2_10     ; Безусловный переход в ПП Bin2_10.

;-----------------------------------------------------------------------------------------------
;                   Применение вычисляемого перехода.
; (преобразование двоично-десятичного кода в код 7-сегментного индикатора)
;-----------------------------------------------------------------------------------------------                
TABLE       addwf       PC,F        ; Содержимое счетчика команд PC увеличивается
                                    ; на величину содержимого аккумулятора W.
            retlw       b'00111111' ; ..FEDCBA = 0               Происходит скачек по таблице
            retlw       b'00000110' ; .....CB. = 1               на строку со значением, 
            retlw       b'01011011' ; .G.ED.BA = 2               записанным в аккумуляторе,
            retlw       b'01001111' ; .G..DCBA = 3               и далее - возврат по стеку.
            retlw       b'01100110' ; .GF..CB. = 4       
            retlw       b'01101101' ; .GF.DC.A = 5      
            retlw       b'01111101' ; .GFEDC.A = 6        
            retlw       b'00000111' ; .....CBA = 7                                     
            retlw       b'01111111' ; .GFEDCBA = 8                                     
            retlw       b'01101111' ; .GF.DCBA = 9                                   
;***********************************************************************************************
            end                     ; Конец программы.
