;***********************************************************************************************
;   ИЛЛЮСТРАЦИЯ ПРИНЦИПА ВЫСОКОСКОРОСТНОГО СЧЕТА ИМПУЛЬСОВ ОТ ВНЕШНЕГО ИСТОЧНИКА ИМПУЛЬСОВ
;                           С ИСПОЛЬЗОВАНИЕМ ТАЙМЕРА TMR0.
;***********************************************************************************************

;***********************************************************************************************
;                                 "ШАПКА ПРОГРАММЫ"
;***********************************************************************************************
; Tmr0.asm   "Заготовка" "программы", в которой осуществляется высокоскоростной счет импульсов
;            от внешнего источника импульсов с использованием таймера TMR0.
;            Используется PIC16F84A.
;            Корабельников Е.А. г.Липецк   http://ikarab.narod.ru  E-mail: karabea@lipetsk.ru
;.............................................................
;===============================================================================================
; Определение положения регистров специального назначения. 
;===============================================================================================
Tmr0        equ        01h         ; Регистр TMR0.
OptionR     equ        01h         ; Регистр Option - банк 1.
Status      equ        03h         ; Регистр Status.
PortA       equ        05h         ; Регистр PortA.
TrisA       equ        05h         ; Регистр TrisA - банк 1.
IntCon      equ        0Bh         ; Регистр IntCon.
;.............................................................
;===============================================================================================
; Определение названия и положения регистров общего назачения.
;===============================================================================================
TimerL      equ        1Bh         ; Регистр младшего разряда 3-байтного двоичного числа.
TimerM      equ        1Ch         ; Регистр среднего разряда 3-байтного двоичного числа.
TimerH      equ        1Dh         ; Регистр старшего разряда 3-байтного двоичного числа.
;.............................................................
;===============================================================================================
; Определение места размещения результатов операций.
;===============================================================================================
W           equ        0           ; Результат направить в аккумулятор.
F           equ        1           ; Результат направить в регистр.
;===============================================================================================
; Присваивание битам названий.
;===============================================================================================
Z           equ        2           ; Флаг нулевого результата.
RP0         equ        5           ; Выбор банка.
;.............................................................       
;===============================================================================================
            org        0           ; Начать выполнение программы 
            goto       START       ; с подпрограммы START.
;***********************************************************************************************



;***********************************************************************************************
;                            РАБОЧАЯ ЧАСТЬ "ПРОГРАММЫ"
;***********************************************************************************************
START       .....................................
;           .....................................
;....       .....................................
;           .....................................
;....       .....................................
;           .....................................
;==============================================================================================
; Подготовительные операции.
;==============================================================================================
            clrf       IntCon      ; Запрет всех прерываний.
            clrf       Tmr0        ; Сброс в 0 содержимого регистра TMR0.
            clrf       TimerH      ; Сброс в 0 содержимого регистра TimerH.

            bsf        Status,RP0  ; Переход в 1-й банк.
            movlw      b'00100111' ; Предделитель с коэффициентом деления 256 включен
            movwf      OptionR     ; перед TMR0, выбор внешнего тактового сигнала с вывода
                                   ; RA4/TOCKI, приращение TMR0 - по переднему фронту. 
;==============================================================================================
; Начало счета (обозначено меткой On).
;==============================================================================================
            movlw      b'00011000' ; Запись в регистр W константы b'00011000' (выводы RA3 и
                                   ; RA4/TOCKI работают "на вход", остальные - "на выход").
On          movwf      TrisA       ; Копирование содержимого регистра W в регистр TrisA (начало
                                   ; счета).
            bcf        Status,RP0  ; Переход в 0-й банк.
;**********************************************************************************************
; НАЧАЛО ГРУППЫ ПП ДИНАМИЧЕСКОЙ ИНДИКАЦИИ (вход в малое и большое кольцо динамической индикации).
;**********************************************************************************************
;           .....................................
;....       .....................................
;           .....................................
;....       .....................................
;           ..................................... 
;===============================================================================================
; Первая проверка на переполнение TMR0
;===============================================================================================
            btfss      IntCon,2    ; TMR0 переполнен или нет?
            goto       DoNothing   ; Нет, не переполнен --> безусловный переход в ПП DoNothing.
            incf       TimerH,F    ; Да, переполнен --> инкремент содержимого регистра TimerH
                                   ; с сохранением результата инкремента в нем же.
            bcf        IntCon,2    ; Сброс флага переполнения TMR0.
            goto       O_K         ; Безусловный переход в ПП O_K.
DoNothing   nop                    ; Выравнивающий NOP.
            nop                    ; Выравнивающий NOP.
            nop                    ; Выравнивающий NOP.
O_K         .....................................
;           .....................................
;....       .....................................
;           .....................................
;***********************************************************************************************
; НИЖНЯЯ ГРАНИЦА МАЛОГО КОЛЬЦА ДИНАМИЧЕСКОЙ ИНДИКАЦИИ.
;***********************************************************************************************
;           .....................................
;***********************************************************************************************
; НИЖНЯЯ ГРАНИЦА БОЛЬШОГО КОЛЬЦА ДИНАМИЧЕСКОЙ ИНДИКАЦИИ.
;***********************************************************************************************
; Группа команд точной "доводки" величины интервала времени основного счета до расчетного значения.
;===============================================================================================
;           .....................................
;           .....................................
;===============================================================================================
; Конец счета (обозначен меткой Off).
;===============================================================================================
            clrw                   ; Сброс в 0 содержимого регистра W.
            movwf      PortA       ; Копирование нуля из регистра W в регистр PortA.

            bsf        Status,RP0  ; Переход в 1-й банк.
            movlw      b'00010000' ; Запись в регистр W константы b'00010000' (вывод RA4/TOCKI
                                   ; работает "на вход", остальные - "на выход".
Off         movwf      TrisA       ; Копирование содержимого регистра W в регистр TrisA (конец
                                   ; счета).
            bcf        Status,RP0  ; Переход в 0-й банк.
;===============================================================================================
; Вторая проверка на переполнение TMR0
;===============================================================================================
            btfss      IntCon,2    ; TMR0 переполнен или нет?
            goto       Analyse     ; Нет, не переполнен --> безусловный переход в ПП Analyse.
            incf       TimerH,F    ; Да, переполнен --> инкремент содержимого регистра TimerH
                                   ; с сохранением результата инкремента в нем же.
            bcf        IntCon,2    ; Сброс флага переполнения TMR0.
;===============================================================================================
; Копирование содержимого регистра TMR0 в регистр TimerM.
;===============================================================================================
Analyse     movf       Tmr0,W      ; Копирование содержимого регистра TMR0 в регистр W.
            movwf      TimerM      ; Копирование содержимого регистра W в регистр TimerM.
;===============================================================================================
; Сброс в 0 содержимого регистра TimerL.
;===============================================================================================
            clrf       TimerL      ; Сброс в 0 содержимого регистра TimerL.
;===============================================================================================
; Подпрограмма досчета.
;===============================================================================================
CountIt     incf       TimerL,F    ; Инкремент содержимого регистра TimerL с сохранением
                                   ; результата инкремента в нем же.
;-----------------------------------------------------------------------------------------------
; Кратковременная разблокировка счетного входа TMR0.
;-----------------------------------------------------------------------------------------------
            bsf        PortA,3     ; Формирование на выводе RA3 единицы.
            nop                    ; Временной "зазор".
            bcf        PortA,3     ; Формирование на выводе RA3 нуля.
            nop                    ; Временной "зазор".
;-----------------------------------------------------------------------------------------------
; Досчет.
;-----------------------------------------------------------------------------------------------
            movf       Tmr0,W      ; Копирование содержимого регистра TMR0 в регистр W.
            bcf        Status,Z    ; Сброс флага нулевого результата Z.
            subwf      TimerM,W    ; Вычесть из содержимого регистра TimerM содержимое регистра W.
            btfsc      Status,Z    ; Результат операции вычитания равен или нет нулю?
            goto       CountIt     ; Да, равен ---> переход в ПП CountIt.
            comf       TimerL,F    ; Нет, не равен ---> инвертировать все биты регистра TimerL 
                                   ; с сохранением результата инвертирования в нем же.
            incf       TimerL,F    ; Инкремент содержимого регистра TimerL с сохранением
                                   ; результата инкремента в нем же.
;===============================================================================================
;           На данный момент, в 3-байтном регистре TimerH/TimerM/TimerL сформирован результат
;           подсчета в виде 3-байтного двоичного числа, которое, далее, можно обрабатывать в
;           группе подпрограмм преобразования двоичных чисел в двоично-десятичные или в группах
;           подпрограмм другого предназначения (в зависимости от специфики разрабатываемого
;           устройства).
;           .....................................
;           .....................................
;....       .....................................
;           .....................................
;....       .....................................
;           .....................................
;***********************************************************************************************
            end                    ; Конец программы.
