;***********************************************************************************************
;*************************** РАБОТА С EEPROM ПАМЯТЬЮ ДАННЫХ ************************************
;***********************************************************************************************


;***********************************************************************************************
;                                 "ШАПКА ПРОГРАММЫ"
;===============================================================================================
;.............................................................
;.............................................................
;===============================================================================================
; Определение положения регистров специального назначения. 
;===============================================================================================
Intcon      equ        0Bh         ; Регистр Intcon.
Status      equ        03h         ; Регистр Status.
EEData      equ        08h         ; EEPROM - данные
EECon1      equ        08h         ; EECON1 - банк1.
EEAdr       equ        09h         ; EEPROM - адрес
EECon2      equ        09h         ; EECON2 - банк1.
;.............................................................
;.............................................................
;===============================================================================================
; Определение названия и положения регистров общего назачения.
;===============================================================================================
Registr     equ        0Ch         ; Регистр оперативной памяти, используемый при работе с EEPROM.
;.............................................................
;.............................................................
;===============================================================================================
; Определение места размещения результатов операций.
;===============================================================================================
W           equ        0           ; Результат направить в аккумулятор.
F           equ        1           ; Результат направить в регистр.
;===============================================================================================
; Присваивание битам названий.
;===============================================================================================
RP0         equ        5           ; Бит выбора банка.
GIE         equ        7           ; Бит глобального разрешения прерываний.
;===============================================================================================
            org        2100h       ; Обращение к EEPROM памяти данных.
            DE         0h,0h,64h   ; Записать в ячейки с адресами .0, .1, .2 
                                   ; числа 0h, 0h, 64h (.100) соответственно.  
            DE         0h,0h,0h    ; Записать в ячейки с адресами .3, .4, .5
                                   ; числа 0h, 0h, 0h соответственно.
            DE         "Korabelnikow E.A. Rus. Lipetsk. 03.2005"  ; Записать в ячейки с адресами
                                                                  ; с .6 по .46 символы.
;===============================================================================================
            org        0           ; Начать выполнение программы 
            goto       START       ; с подпрограммы START.
;***********************************************************************************************

;------------------------------------------------------------------------------------------------
;                              ПОЯСНЕНИЯ ПО ДИРЕКТИВЕ DE
;------------------------------------------------------------------------------------------------
;                                                       Содержимое EEPROM
;  1.   Для  случая, указанного --->     00 00 64 00 00 00 xx xx   xx xx xx xx xx xx xx xx
;       в "шапке" программы     --->     xx xx xx xx xx xx xx xx   xx xx xx xx xx xx xx xx
;                               --->     xx xx xx xx xx xx xx xx   xx xx xx xx xx xx xx FF
;                               --->     FF FF FF FF FF FF FF FF   FF FF FF FF FF FF FF FF
;                                     xx - 16-ричные числа символов, включая и пробелы.
;------------------------------------------------------------------------------------------------                                        
;  2.           А можно и так:

;            org        2100h   --->     00 00 64 FF FF FF FF FF   FF FF FF FF FF FF FF FF
;            DE         0h,0h,64h-->     FF FF FF FF FF FF FF FF   FF FF FF FF FF FF FF FF
;                               --->     FF FF FF FF FF FF FF FF   FF FF FF FF FF FF FF FF
;                               --->     FF FF FF FF FF FF FF FF   FF FF FF FF FF FF FF FF
;------------------------------------------------------------------------------------------------

;***********************************************************************************************
;                               РАБОЧАЯ ЧАСТЬ ПРОГРАММЫ
;***********************************************************************************************
START                              ; .........................
;.............................................................
;===============================================================================================
;                               Чтение данных из EEPROM
;===============================================================================================
; Считывание содержимого байта с адресом 02h и запись его в регистр общего назначения Registr.
;-----------------------------------------------------------------------------------------------
            bcf        Status,RP0  ; Переход в нулевой банк.

            movlw      2           ; Записать в регистр W константу 02h.
            movwf      EEAdr       ; Скопировать 02h из регистра W в регистр EEAdr.

            bsf        Status,RP0  ; Переход в первый банк.
            bsf        EECon1,0    ; Инициализировать чтение.
            bcf        Status,RP0  ; Переход в нулевой банк.

            movf       EEData,W    ; Скопировать число из ячейки EEPROM с адресом 02h в регистр W.
            movwf      Registr     ; Скопировать число из регистра W в регистр Registr.
;-----------------------------------------------------------------------------------------------
; Изменение содержимого регистра Registr.
;-----------------------------------------------------------------------------------------------
            incf       Registr,F   ; Увеличить на 1 содержимое регистра Registr с 
                                   ; сохранением результата в нем же.
;===============================================================================================
;                                Запись данных в EEPROM.             
;===============================================================================================
; Запись содержимого регистра Registr в ячейку EEPROM с адресом 02h.
;-----------------------------------------------------------------------------------------------
            bcf        Intcon,GIE  ; Глобальный запрет прерываний.
 
            movlw      2           ; Записать в регистр W константу 02h.
            movwf      EEAdr       ; Скопировать константу 02h из регистра W в регистр EEAdr.
 
            movf       Registr,W   ; Скопировать число из регистра Registr в регистр W.
            movwf      EEData      ; Скопировать число из регистра W в ячейку EEPROM с адресом 02h.

            bsf        Status,RP0  ; Переход в первый банк.
            bsf        EECon1,2    ; Разрешить запись. 
                                    
            movlw      055h        ; Обязательная
            movwf      EECon2      ; процедура
            movlw      0AAh        ; при записи.
            movwf      EECon2      ; ----"----
            bsf        EECon1,1    ; ----"----

            bcf        EECon1,4    ; Сбросить флаг прерывания по окончании записи в EEPROM.
            bcf        Status,RP0  ; Переход в нулевой банк.
;------------------------------------------------------------------
; Примечание: время исполнения полного цикла программы должно быть 
; более времени, необходимого для окончания записи в EEPROM.
;------------------------------------------------------------------
;...................................................................
;...................................................................
            goto       START       ; Переход на новый цикл программы.
;***********************************************************************************************
            end                    ; Конец программы.

Примечание: регистр EECon2 не реализован физически. Он используется в операциях записи
            в EEPROM память данных для реализации обязательной последовательности команд.











  
