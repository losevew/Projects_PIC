;*********************************************************************************************
; Retr_1.asm ВАРИАНТ С ПРЕРЫВАНИЯМИ
; Сканер для ретранслятора VERTEX-7000VXR.
; Автор: Корабельников Евгений Александрович  г.Липецк  декабрь 2004г.
; E-mail: karabea@lipetsk.ru              http://ikarab.narod.ru
;*********************************************************************************************
; Позволяет перевести VERTEX-7000VXR и другие подобные ретрансляторы из режима односторонней 
; ретрансляции в режим двухсторонней ретрансляции без потери качества работы.
;*********************************************************************************************
; Используется микроконтроллер PIC16F84A. Частота кварца 4000кГц.
;*********************************************************************************************
            LIST       p=16F84a    ; Используется PIC16F84A.
            __CONFIG   03FF5H      ; WDT включен, бит защиты не установлен.
;=============================================================================================
; Определение положения регистров специального назначения.
;=============================================================================================
OptionR     equ        01h         ; Option - банк1
Status      equ        03h         ; Регистр Status
PortB       equ        06h         ; Порт B
TrisB       equ        06h         ; Tris B - Банк1
IntCon      equ        0Bh         ; Регистр IntCon
;=============================================================================================
; Определение названия и положения регистров общего назначения.
;=============================================================================================
Trigg       equ        0Ch         ; Переключатель направления ретрансляции.

W_Temp      equ        0Eh         ; Регистр сохранения содержимого W при прерываниях.
Stat_Temp   equ        0Fh         ; Регистр сохранения содержимого STATUS при прерываниях.

SecH        equ        1Eh         ; Старший байт счетчика времени сканирования.
SecL        equ        1Fh         ; Младший байт счетчика времени сканирования.

SecH_1      equ        1Ch         ; Старший байт счетчика защитного интервала времени.
SecL_1      equ        1Dh         ; Младший байт счетчика защитного интервала времени.

SecH_2      equ        1Ah         ; Старший байт счетчика задержки рабочей точки программы
                                   ; в прерывании.
SecL_2      equ        1Bh         ; Младший байт счетчика задержки рабочей точки программы
                                   ; в прерывании.
;=============================================================================================
; Определение  места  размещения результатов операций.
;=============================================================================================
W           equ        0           ; Результат направить в аккумулятор.
F           equ        1           ; Результат направить в регистр.
;=============================================================================================
; Определение положения флагов и бита выбора банка в регистре STATUS.
;=============================================================================================
RP0         equ        5           ; Бит выбора банка.
;=============================================================================================
; Точка входа в программу.
;=============================================================================================
            org        0           ; Начать выполнение программы с нулевого адреса PC
            goto       START       ; (с первой команды подпрограммы START).
;=============================================================================================
; Точка входа в прерывание.
;=============================================================================================
            org        4           ; Назначение вектора прерывания (назначается, если
                                   ; в программе используются прерывания).
;=============================================================================================
; Объем программы: 63 слова в памяти программ.
;*********************************************************************************************


;*********************************************************************************************
; НАЧАЛО ПРЕРЫВАНИЯ.
;============================================================================================
; Сохранение  содержимого регистров STATUS и W в ОЗУ.
;--------------------------------------------------------------------------------------------
INT         movwf      W_Temp      ; Скопировать содержимое регистра W в регистр W_Temp.
            movf       Status,W    ; Скопировать содержимое регистра Status в регистр W.
            movwf      Stat_Temp   ; Скопировать содержимое регистра W в регистр Stat_Temp.
;--------------------------------------------------------------------------------------------
; Проверка наличия несущей (опрос клавиатуры).
;--------------------------------------------------------------------------------------------
CYCLE       btfsc      PortB,0     ; Проверка состояния нулевого бита регистра PortB.
            goto       EndInt      ; Если он =1 (несущей нет), то уход в ПП выхода из прерывания.
                                   ; Если он =0 (несущая есть), то программа исполняется далее.
;--------------------------------------------------------------------------------------------
; Формирование времени одного цикла задержки рабочей точки программы в прерывании.
;--------------------------------------------------------------------------------------------
            movlw      .250        ; Закладка константы .250 в регистр W.  
            movwf      SecH_2      ; Копирование .250 из регистра W в регистр SecH_2.       
                                                            
            movlw      .120        ; Закладка константы .120 в регистр W.
            movwf      SecL_2      ; Копирование .120 из регистра W в регистр SecL_2.

PAUSE_2     clrwdt                 ; Сброс WDT.
          
            decfsz     SecL_2,F    ; Декремент содержимого младшего разряда счетчика SecL_2.
            goto       PAUSE_2     ; Если результат декремента не =0, то переход в ПП PAUSE_2.                   
  
            incfsz     SecH_2,F    ; Если результат декремента =0, то - инкремент старшего разряда счетчика SecH_2.
            goto       PAUSE_2     ; Если результат инкремента не=0, то переход в ПП PAUSE_2.
            goto       CYCLE       ; Если результат инкремента =0, то переход на следующий цикл
                                   ; задержки рабочей точки программы в прерывании.   
;============================================================================================
; Восстановление содержимого регистров STATUS и W с последующим выходом из прерывания.
;--------------------------------------------------------------------------------------------
EndInt      bcf        IntCon,1    ; Сброс флага прерывания по INT.

            movf       Stat_Temp,W ; Скопировать содержимое регистра Stat_Temp в регистр W.
            movwf      Status      ; Скопировать содержимое регистра W в регистр Status.
            swapf      W_Temp,F    ; Поменять местами старший и младший полубайты регистра W_Temp
                                   ; с сохранением результата операции в нем же.
            swapf      W_Temp,W    ; Поменять местами старший и младший полубайты регистра W_Temp
                                   ; с сохранением результата операции в регистре W.
            retfie                 ; Возврат из прерывания по стеку.
;*********************************************************************************************
; КОНЕЦ ПРЕРЫВАНИЯ
;*********************************************************************************************



;*********************************************************************************************
; СКАНИРОВАНИЕ
;*********************************************************************************************
; Подготовительные операции.
;---------------------------------------------------------------------------------------------
START       clrf       IntCon      ; Запретить все прерывания.

            clrwdt                 ; Сбросить сторожевой таймер WDT.

            bsf        Status,RP0  ; Установить банк 1.

            movlw      .1          ; RB0 работает на вход,
            movwf      TrisB       ; остальные - на выход.

            movlw      .0          ; Включить подтягивающие резисторы порта В.
            movwf      OptionR     ; На входе INT прерывания - по заднему фронту.

            bcf        Status,RP0  ; Установить банк 0.

;--------------------------------------------------------------------------------------------
; Выбор направления ретрансляции.
;--------------------------------------------------------------------------------------------
TRIGGER     btfsc      Trigg,0     ; Проверка значения нулевого бита регистра Trigg.
            goto       Metka148    ; Если это значение =1, то переход на метку Metka148.  
                                   ; Если это значение =0, то программа исполняется далее.

            movlw      .251        ; Закладка константы .251 (1111 1011) в регистр W.
            movwf      PortB       ; Копирование .251 из регистра W в регистр PortB.
                                   ; (выбор прямого направления ретрансляции: ПРМ-X, ПРД-Y).

            goto       Metka_1     ; Безусловный переход на метку Metka_1.

Metka148    movlw      .255        ; Закладка константы .255 (1111 1111) в регистр W.    
            movwf      PortB       ; Копирование .255 из регистра W в регистр PortB.        
                                   ; (выбор обратного направления ретрансляции: ПРМ-Y, ПРД-X).
;--------------------------------------------------------------------------------------------
; Формирование защитного интервала времени (ожидание окончания переходных процессов,
; возникающих при смене направлений ретрансляции) равного, примерно, 60 мс.
;--------------------------------------------------------------------------------------------
Metka_1     movlw      .197        ; Закладка в регистр W константы .197  
            movwf      SecH_1      ; Копирование константы .197 из регистра W в регистр SecH_1.         
                                                           
            movlw      .121        ; Закладка в регистр W константы .121
            movwf      SecL_1      ; Копирование константы .121 из регистра W в регистр SecL_1.


PAUSE_D     clrwdt                 ; Сброс WDT.
          
            decfsz     SecL_1,F    ; Декремент содержимого младшего разряда счетчика SecL_1
            goto       PAUSE_D     ; Если результат декремента не =0, то переход в ПП PAUSE_D.                    
  
            incfsz     SecH_1,F    ; Если результат декремента =0, то - инкремент старшего разряда счетчика SecH_1.
            goto       PAUSE_D     ; Если результат инкремента не=0, то переход в ПП PAUSE_D.
                                   ; Если результат инкремента =0, то программа исполняется далее.
;============================================================================================
; Формирование интервала времени сканирования.
;============================================================================================
            movlw      .245        ; Закладка константы .245 в регистр W.    
            movwf      SecH        ; Копирование .245 из регистра W в регистр SecH.        
                                   ;                      
            movlw      .255        ; Закладка константы .255 в регистр W.
            movwf      SecL        ; Копирование .255 из регистра W в регистр SecL.
;--------------------------------------------------------------------------------------------
; Разрешение прерываний INT.
;--------------------------------------------------------------------------------------------
            movlw      .144        ; Закладка константы .144 в регистр W.
            movwf      IntCon      ; Копирование .144 (1001 0000) из регистра W в регистр IntCon
                                   ; (разрешение прерываний по входу INT).
;--------------------------------------------------------------------------------------------
PAUSE       clrwdt                 ; Сброс WDT.

            decfsz     SecL,F      ; Декремент содержимого младшего разряда счетчика SecL.
            goto       PAUSE       ; Если результат декремента не=0, то переход в ПП PAUSE.
  
            incfsz     SecH,F      ; Если результат декремента =0, - то инкремент старшего разряда счетчика SecH.
            goto       PAUSE       ; Если результат инкремента не=0, то переход в ПП PAUSE.
                                   ; Если результат инкремента =0, то программа исполняется дальше.
;--------------------------------------------------------------------------------------------
; Изменение направления ретрансляции.
;--------------------------------------------------------------------------------------------
            clrf       IntCon      ; Запрет всех прерываний.

            incf       Trigg,F     ; Увеличение на 1 (инкремент) содержимого переключателя
                                   ; направления ретрансляции.
            goto       START       ; Переход на новый цикл сканирования.
;********************************************************************************************
            end                    ; Конец программы.                                 




