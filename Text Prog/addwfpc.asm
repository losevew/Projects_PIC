
;***********************************************************************************************
;                         ПРИМЕРЫ ИСПОЛЬЗОВАНИЯ ВЫЧИСЛЯЕМЫХ ПЕРЕХОДОВ
;***********************************************************************************************

;===============================================================================================
;************************************** ПРИМЕР № 1 *********************************************
;===============================================================================================
; В данном случае, клавиатура подключена к выводам RA0 и RA1 (2 кнопки или тумблера).
; В "шапке" программы должен быть "прописан" регистр PC (PC  equ  02h) и до
; исполнения команды movf PortA,W, выводы порта А, подключенные к клавиатуре, должны быть
; установлены на работу "на вход".
;-----------------------------------------------------------------------------------------------
            ......     ......      ;
            ......     ......      ;
            movf       PortA,W     ; Опрос клавиатуры (копирование числа, присутствующего на 
                                   ; выводах порта А, в регистр W).
;-----------------------------------------------------------------------------------------------
;                        Применение вычисляемого перехода.
; (переход на исполнение различных сценариев в зависимости от состояния клавиатуры)
;-----------------------------------------------------------------------------------------------
            addwf      PC,F        ; Увеличение PC в зависимости от состояния клавиатуры
                                   ; (числа, записанного при опросе клавиатуры, в регистр W).

            goto       Function    ; Режим установки ПЧ.                 0000 0000  
            goto       Plus        ; "Плюс ПЧ".                          0000 0001  
            goto       Minus       ; "Минус ПЧ".                         0000 0010  

            ......     ......      ; Программа исполняется далее         0000 0011  
            ......     ......      ;
;-----------------------------------------------------------------------------------------------

;===============================================================================================
;************************************** ПРИМЕР № 2 *********************************************
;===============================================================================================
; В "шапке" программы должен быть "прописан" регистр PC (PC  equ  02h).
;-----------------------------------------------------------------------------------------------
            ......     ......      ;
            ......     ......      ; 
            call       TABLE       ; Переход по стеку в ПП TABLE.

            ......     ......      ;<--Возврат по стеку из ПП TABLE, после чего программа
            ......     ......      ; исполняется далее.
;-----------------------------------------------------------------------------------------------
;                   Применение вычисляемого перехода.
; (преобразование двоично-десятичного кода в код 7-сегментного индикатора)
;-----------------------------------------------------------------------------------------------                
TABLE       addwf      PC,F        ; Содержимое счетчика команд PC увеличивается
                                   ; на величину содержимого аккумулятора W.
            retlw      b'00111111' ; ..FEDCBA = 0            
            retlw      b'00000110' ; .....CB. = 1             
            retlw      b'01011011' ; .G.ED.BA = 2           
            retlw      b'01001111' ; .G..DCBA = 3           
            retlw      b'01100110' ; .GF..CB. = 4       
            retlw      b'01101101' ; .GF.DC.A = 5       
            retlw      b'01111101' ; .GFEDC.A = 6       
            retlw      b'00000111' ; .....CBA = 7                                     
            retlw      b'01111111' ; .GFEDCBA = 8                                     
            retlw      b'01101111' ; .GF.DCBA = 9                                   
            retlw      .00         ; ........ = Все секторы погашены.                 
            retlw      .113        ; .GFE...A = F  Признак режима установки ПЧ.
            retlw      .246        ; HGFE.CB. = H. Признак режима "плюс ПЧ".               
            retlw      .184        ; H.FED... = L. Признак режима "минус ПЧ".
            retlw      .241        ; HGFE...A = F. Признак режима частотомера.
;----------------------------------------------------------------------------------------------


