
;--------------------------------- "ШАПКА"  ПРОГРАММЫ ----------------------------------------
;*********************************************************************************************
; Файл текста программы: cus_1.asm          ВАРИАНТ КОММЕНТАРИЯ № 1
; Программа разработана для устройства тонального вызова с частотой 1450 Гц.
;********************************************************************************************* 
; Автор: Корабельников Евгений Александрович  г.Липецк,  январь 2005г.
; E-mail: karabea@lipetsk.ru                   URL: http://ikarab.narod.ru
;*********************************************************************************************
; Используется микроконтроллер PIC16F84A. Частота кварца 4000кГц.
;*********************************************************************************************
; Объем программы: 46 слов в памяти программ.
;*********************************************************************************************
            LIST       p=16F84A    ; Назначение типа ПИКа: PIC16F84A.
            __CONFIG   03FF5H      ; Установка битов  конфигурации: стандартный XT-генератор,
                                   ; WDT включен, бит защиты не установлен, PWRT
                                   ; включен (1111 0101).
;=============================================================================================
; Определение адресов регистров специального назначения.
;=============================================================================================
OptionR     equ        01h         ; Регистр Option - банк1
Status      equ        03h         ; Регистр Status
PortB       equ        06h         ; Порт B
TrisB       equ        06h         ; Регистр Tris B - Банк1
IntCon      equ        0Bh         ; Регистр IntCon
;=============================================================================================
; Определение названия и адресов регистров общего назначения.
;=============================================================================================
Sec         equ        0Ch         ; Счетчик времени полупериода.

SecH        equ        0Dh         ; Старший байт таймера.
SecL        equ        0Eh         ; Младший байт таймера.
;=============================================================================================
; Присвоение буквенного обозначения операции направления результата выполнения команды в
; регистр, с содержимым которого производится действие (для удобства восприятия текста
; программы).
;=============================================================================================
F           equ        1           ; Результат направить в регистр, с содержимым которого
                                   ; производится действие.
;=============================================================================================
; Присвоение биту выбора банка регистра STATUS (пятому) его стандартного названия 
; для удобства восприятия текста программы).
;=============================================================================================
RP0         equ        5           ; Присвоение 5-му биту регистра STATUS названия RP0.
;=============================================================================================
; Определение точки входа в программу.
;=============================================================================================
            org        0           ; Начать выполнение программы
            goto       START       ; с первой команды подпрограммы START.
;*********************************************************************************************

;------------------------------- РАБОЧАЯ  ЧАСТЬ  ПРОГРАММЫ -----------------------------------
;*********************************************************************************************
; Подготовительные операции.
;---------------------------------------------------------------------------------------------
START       clrf       IntCon      ; Запрещение всех прерываний.

            clrwdt                 ; Сброс сторожевого таймера WDT.

            bsf        Status,RP0  ; Установка банка 1.

            movlw      .65         ; RB0,RB6 работают на вход,        (.65 = 0100 0001)
            movwf      TrisB       ; остальные - на выход.

            movlw      .143        ; Выключение подтягивающих резисторов порта В.
            movwf      OptionR     ; Предделитель с Кдел.=128 (18мс.*128=2,3сек.) подключен 
                                   ; к WDT, остальное - не важно.
                                   ;            (.143 = 1000 1111)

            bcf        Status,RP0  ; Установка банка 0.                        
;--------------------------------------------------------------------------------------------
; Запись констант времени работы таймера.
;--------------------------------------------------------------------------------------------
            movlw      .15         ; Запись в регистр SecH
            movwf      SecH        ; константы .15

            movlw      .255        ; Запись в регистр SecL
            movwf      SecL        ; константы .255
;--------------------------------------------------------------------------------------------
; Проверка наличия включения на передачу (опрос клавиатуры).
;--------------------------------------------------------------------------------------------
CYCLE       btfsc      PortB,0     ; Если передача не включена - переход в ПП START.
            goto       START       ; Если включена - программа исполняется далее.
;--------------------------------------------------------------------------------------------
; Проверка: режим тонального вызова включен или выключен ?
;--------------------------------------------------------------------------------------------
            btfss      PortB,6     ; Если режим тонального вызова выключен - уход в PRD.
            goto       PRD         ; Если включен - программа исполняется далее.
;--------------------------------------------------------------------------------------------
; Формирование времени отрицательного полупериода сигнала тонального вызова.
;--------------------------------------------------------------------------------------------
            bcf        PortB,2     ; Начало формирования отрицательного полупериода.
            nop                    ; Пустые машинные циклы точной калибровки
            nop                    ; времени отрицательного полупериода (точная доводка).
            nop                    ; ----------------------"------------------------
      
            movlw      .85         ; Запись в регистр Sec 
            movwf      Sec         ; константы .85

PAUSE_1     clrwdt                 ; Сброс сторожевого таймера WDT.
          
            decfsz     Sec,F       ; "Грубый" отсчет интервала времени
            goto       PAUSE_1     ; отрицательного полупериода.
;--------------------------------------------------------------------------------------------
; Формирование времени положительного полупериода сигнала тонального вызова.
;--------------------------------------------------------------------------------------------                      
            bsf        PortB,2     ; Начало формирования положительного полупериода.
            nop                    ; Пустые машинные циклы точной калибровки
            nop                    ; времени положительного полупериода (точная доводка).
            nop                    ; ----------------------"----------------------
            movlw      .83         ; Запись в регистр Sec 
            movwf      Sec         ; константы .83

PAUSE_2     clrwdt                 ; Сброс сторожевого таймера WDT.
          
            decfsz     Sec,F       ; "Грубый" отсчет интервала времени
             goto       PAUSE_2     ; положительного полупериода.
;--------------------------------------------------------------------------------------------
; "Очистка" (декремент) таймера.
;--------------------------------------------------------------------------------------------          
            decfsz     SecL,F      ; Декремент содержимого регистра SecL.
            goto       CYCLE       ; Если результат декремента не=0 - переход на ПП CYCLE.                    
                                   ; Если результат декремента =0 - программа исполняется далее.

            decfsz     SecH,F      ; Декремент содержимого регистра SecH.
            goto       CYCLE       ; Если результат декремента не=0 - переход на ПП CYCLE.
                                   ; Если результат декремента =0 - программа исполняется далее.

            bcf        PortB,2     ; Установить на выходе RB2 ноль.
;--------------------------------------------------------------------------------------------
; Уход рабочей точки программы в "вечное" кольцо и выход из него после
; переключения р/станции с передачи на прием.
;--------------------------------------------------------------------------------------------
PRD         clrwdt                 ; Сброс сторожевого таймера WDT.
            btfss      PortB,0     ; Передача включена?
            goto       PRD         ; Если да, то переход на ПП PRD.
                                   ; Если нет, то программа исполняется далее.
;           Еще одна проверка.

            btfss      PortB,0     ; Передача включена?
            goto       PRD         ; Если да, то переход на ПП PRD.
                                   ; Если нет, то программа исполняется далее.

            goto       START       ; Конец полного цикла программы, переход на 
                                   ; новый полный цикл программы.
;============================================================================================
            end                    ; Конец программы.






   

