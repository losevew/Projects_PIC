;*********************************************************************************************
; Retr_3.asm ВАРИАНТ БЕЗ ПРЕРЫВАНИЙ
; Сканер для ретранслятора VERTEX-7000VXR. 
; Автор: Корабельников Евгений Александрович  г.Липецк  декабрь 2004г.
; E-mail: karabea@lipetsk.ru              http://ikarab.narod.ru
;*********************************************************************************************
; Позволяет перевести VERTEX-7000VXR и другие подобные ретрансляторы из режима односторонней 
; ретрансляции в режим двухсторонней ретрансляции без потери качества работы.
;*********************************************************************************************
; Используется микроконтроллер PIC16F84A. Частота кварца 4000кГц.
;*********************************************************************************************
            LIST      p=16F84a     ; Используется PIC16F84A.
            __CONFIG  03FF5H       ; WDT включен, бит защиты не установлен.
;=============================================================================================
; Определение  положения регистров специального назначения.
;=============================================================================================
OptionR     equ        01h         ; Option - банк1
Status      equ        03h         ; Регистр Status
PortB       equ        06h         ; Порт B
TrisB       equ        06h         ; Tris B - Банк1
IntCon      equ        0Bh         ; Регистр IntCon
;=============================================================================================
; Определение названия и положения регистров общего назначения.
;=============================================================================================
Trigg       equ        0Ch         ; Переключатель направления ретрансляции.

SecH        equ        1Eh         ; Старший байт счетчика времени сканирования.
SecL        equ        1Fh         ; Младший байт счетчика времени сканирования.

SecH_1      equ        1Ch         ; Старший байт счетчика защитного интервала времени.
SecL_1      equ        1Dh         ; Младший байт счетчика защитного интервала времени.
;=============================================================================================
; Определение места размещения результатов операций.
;=============================================================================================
F           equ        1           ; Результат направить в регистр.
;=============================================================================================
; Определение положения флагов (флаги не задействованы) и бита выбора банка в регистре Status.
;=============================================================================================
RP0         equ        5           ; Бит выбора банка.
;=============================================================================================
; Точка входа в программу.
;=============================================================================================
            org        0           ; Начать выполнение программы с нулевого адреса PC
            goto       START       ; (с первой команды подпрограммы START).
;=============================================================================================
; Объем программы: 40 слов в памяти программ.
;*********************************************************************************************

;                              РАБОЧАЯ ЧАСТЬ ПРОГРАММЫ
;*********************************************************************************************
; Подготовительные операции.
;---------------------------------------------------------------------------------------------
START       clrf       IntCon      ; Запретить все прерывания.

            clrwdt                 ; Сбросить сторожевой таймер WDT.

            bsf        Status,RP0  ; Установить банк 1.

            movlw      .1          ; RB0 работает на вход,
            movwf      TrisB       ; остальные - на выход.

            movlw      .0          ; Включить подтягивающие резисторы порта В.
            movwf      OptionR     ; Остальное - не существенно.

            bcf        Status,RP0  ; Установить банк 0.

;--------------------------------------------------------------------------------------------
; Выбор направления ретрансляции.
;--------------------------------------------------------------------------------------------
TRIGGER     btfsc      Trigg,0     ; Проверка значения нулевого бита регистра Trigg.
            goto       Metka148    ; Если это значение =1, то переход на метку Metka148.               
                                   ; Если это значение =0, то программа исполняется далее.

            movlw      .251        ; Закладка константы .251 (1111 1011) в регистр W.
            movwf      PortB       ; Копирование .251 из регистра W в регистр PortB.
                                   ; (выбор прямого направления ретрансляции: ПРМ-X, ПРД-Y).
           
            goto       Metka_1     ; Безусловный переход на метку Metka_1.

Metka148    movlw      .255        ; Закладка константы .255 (1111 1111) в регистр W. 
            movwf      PortB       ; Копирование .255 из регистра W в регистр PortB.
                                   ; (выбор обратного направления ретрансляции: ПРМ-Y, ПРД-X).
;--------------------------------------------------------------------------------------------
; Формирование защитного интервала времени (ожидание окончания переходных процессов,
; возникающих при смене направлений ретрансляции) равного, примерно, 60 мс.
;--------------------------------------------------------------------------------------------
Metka_1     movlw      .197        ; Закладка в регистр W константы .197  
            movwf      SecH_1      ; Копирование константы .197 из регистра W в регистр SecH_1.         
                                 
            movlw      .121        ; Закладка в регистр W константы .121
            movwf      SecL_1      ; Копирование константы .121 из регистра W в регистр SecL_1.


PAUSE_D     clrwdt                 ; Сброс WDT.
          
            decfsz     SecL_1,F    ; Декремент содержимого младшего разряда счетчика SecL_1
            goto       PAUSE_D     ; Если результат декремента не=0, то переход в ПП PAUSE_D.                    
  
            incfsz     SecH_1,F    ; Если результат декремента =0, то инкремент старшего разряда счетчика SecH_1
            goto       PAUSE_D     ; Если результат инкремента не=0, то переход в ПП PAUSE_D.
                                   ; Если результат инкремента =0, то программа исполняется далее.
;============================================================================================
; Формирование интервала времени сканирования.
;============================================================================================
            movlw      .245        ; Закладка константы .245 в регистр W.   
            movwf      SecH        ; Копирование .245 из регистра W в регистр SecH.          
                                                          
            movlw      .255        ; Закладка константы .255 в регистр W.
            movwf      SecL        ; Копирование .255 из регистра W в регистр SecL.
;--------------------------------------------------------------------------------------------
PAUSE       clrwdt                 ; Сброс WDT.

            btfss      PortB,0     ; Несущая есть?
            goto       PAUSE       ; Да.
                                   
            btfss      PortB,0     ; Нет. Программа выполняется дальше. Несущая есть ?
            goto       PAUSE       ; Да.
 
            decfsz     SecL,F      ; Нет. Декремент содержимого младшего разряда счетчика SecL.
            goto       PAUSE       ; Если результат декремента не=0, то переход в ПП PAUSE.
  
            incfsz     SecH,F      ; Если результат декремента =0, то инкремент старшего разряда счетчика SecH.
            goto       PAUSE       ; Если результат инкремента не=0, то переход в ПП PAUSE.
                                   ; Если результат инкремента =0, то программа исполняется далее.
;--------------------------------------------------------------------------------------------
; Изменение направления ретрансляции.
;--------------------------------------------------------------------------------------------
            incf       Trigg,F     ; Увеличение на 1 (инкремент)содержимого переключателя
                                   ; направления ретрансляции.
            goto       START       ; Переход на новый цикл сканирования.
;********************************************************************************************
            end                    ; Конец программы.                                 




